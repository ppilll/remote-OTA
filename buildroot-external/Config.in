## buildroot-external/Config.in
```kconfig
menu "EdgeGuard"

source "$BR2_EXTERNAL_EDGEGUARD_PATH/package/edgeguard-rk-ab/Config.in"
source "$BR2_EXTERNAL_EDGEGUARD_PATH/package/edgeguard-remote-ota/Config.in"

endmenu
```

## buildroot-external/package/edgeguard-provisioning/Config.in
```kconfig
config BR2_PACKAGE_EDGEGUARD_PROVISIONING
	bool "edgeguard-provisioning"
	depends on BR2_USE_MMU
	depends on BR2_USE_WCHAR
	depends on BR2_TOOLCHAIN_HAS_THREADS
	depends on !BR2_STATIC_LIBS
	select BR2_PACKAGE_LIBGLIB2
	select BR2_PACKAGE_JSON_GLIB
	help
	  EdgeGuard BLE provisioning daemon using GLib/GIO/GDBus,
	  JSON-GLib, BlueZ, ConnMan and Linux input APIs.

	  BlueZ, ConnMan and system D-Bus are runtime requirements. Their exact
	  vendor-SDK BR2 symbols must be confirmed before adding select clauses;
	  this external tree does not contain those symbol definitions.
```

## buildroot-external/package/edgeguard-remote-ota/Config.in
```kconfig
config BR2_PACKAGE_EDGEGUARD_REMOTE_OTA
	bool "edgeguard-remote-ota"
	depends on BR2_PACKAGE_RAUC
	depends on BR2_USE_MMU
	depends on BR2_USE_WCHAR
	depends on BR2_TOOLCHAIN_HAS_THREADS
	depends on !BR2_STATIC_LIBS
	select BR2_PACKAGE_EDGEGUARD_RK_AB
	select BR2_PACKAGE_LIBCURL
	select BR2_PACKAGE_LIBGLIB2
	select BR2_PACKAGE_JSON_GLIB
	help
	  GNU11 EdgeGuard remote OTA Agent, RAUC pre-install safety gate,
	  static symmetric RAUC profile and BusyBox/SysV startup integration.
	  Requires provisioned /etc/rauc/keyring.pem and persistent /userdata.

if BR2_PACKAGE_EDGEGUARD_REMOTE_OTA

config BR2_PACKAGE_EDGEGUARD_REMOTE_OTA_RELEASE_FILE
	string "Release identity JSON input (absolute build-machine path)"
	help
	  Required JSON with schema_version, device_compatible, rauc_compatible,
	  version and build_id for THIS image. See release.json.in and README.md.
	  Build fails if missing, invalid, or template placeholders remain.
	  No server-derived identity and no generated fallback version.

endif
```

## buildroot-external/package/edgeguard-rk-ab/Config.in
```kconfig
config BR2_PACKAGE_EDGEGUARD_RK_AB
bool "edgeguard-rk-ab"
depends on BR2_PACKAGE_RAUC
help
  EdgeGuard Rockchip native A/B integration for RAUC.

  Installs:
    /usr/bin/edgeguard-rk-abctl
    /usr/libexec/rauc/edgeguard-rk-ab-backend
```
